## drivers/media/isdbt/Kconfig
```kconfig
config ISDBT
	bool "isdbt"
	default n

config ISDBT_FC8300
	bool "ISDBT_FC8300"

config ISDBT_SPMI
	bool "isdbt spmi"
	default n

config ISDBT_ANT_DET
	bool "isdbt antenna detection"
	default n
```
